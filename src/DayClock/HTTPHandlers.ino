void to_xml(float temperature, float humidity, int co2, int lastSensorTimestamp, char *buf, int len)
{
  snprintf(buf, len - 1, "<xml millis=\"%lu\" ts=\"%d\"><temp_f>%0.2f</temp_f><temp_c>%0.2f</temp_c><humidity>%0.2f</humidity><co2>%d</co2></xml>", millis(), lastSensorTimestamp, c_to_f(temperature), temperature, humidity, co2);
}

void to_json(float temperature, float humidity, int co2, int lastSensorTimestamp, char *buf, int len)
{
  snprintf(buf, len - 1, "{\"temp_f\": %0.2f, \"temp_c\": %0.2f, \"humidity\": %0.2f, \"co2\": %d, \"timestamp\": %d, \"millis\": %lu, \"timestamp_str\": \"%s\"}", c_to_f(temperature), temperature, humidity, co2, lastSensorTimestamp, millis(), lastSensorLocaltime);
}

void httpRootHandler(AsyncWebServerRequest *request)
{
  Serial.println("HTTP request from " + request->client()->remoteIP().toString() + ": / [" + String(millis()) + "]");

  const char *html = R"(
<html>
   <head>
        <meta charset='UTF-8'>
        <meta name='viewport' content='width=device-width, initial-scale=1.0'>
        <title>Dayclock  %0.2f° %s / %d ppm</title>
        <script>
            setInterval(updateValues, 5000);

            function updateValues() {
                var use_celsius = %s;
                var xmlhttp = new XMLHttpRequest();
                xmlhttp.onreadystatechange = function() {
                    if (this.readyState == 4 && this.status == 200) {
                        var data = JSON.parse(this.responseText);
                        if (data.temp_f)
                            document.getElementById('temp_f_val').innerHTML = data.temp_f;
                        if (data.temp_c)
                            document.getElementById('temp_c_val').innerHTML = data.temp_c;
                        if (data.humidity)
                            document.getElementById('humidity_val').innerHTML = data.humidity;
                        if (data.co2)
                            document.getElementById('co2_val').innerHTML = data.co2;
                        if (data.timestamp)
                            document.getElementById('timestamp_val').innerHTML = data.timestamp_str;

                        document.title = 'Dayclock';
                        if (use_celsius)
                        {
                            document.title += "  " + document.getElementById('temp_c_val').innerHTML + '° C';
                        }
                        else
                        {
                            document.title += "  " + document.getElementById('temp_f_val').innerHTML + '° F';
                        }
                        document.title += ' / ' + document.getElementById('co2_val').innerHTML + ' ppm';
                    }
                };
                xmlhttp.open("GET", '/json', true);
                xmlhttp.send();
            }
        </script>
        <noscript>
            <meta http-equiv='refresh' content='5'/>
        </noscript>
        <style>
          dl { border: 3px double #ccc;  padding: 0.5em; width: 320px; }
          dt { float: left; clear: left; width: 100px; text-align: right; font-weight: bold; color: green; }
          dt::after { content: ':'; }
          dd { margin: 0 0 0 110px; padding: 0 0 0.5em 0; }
          %s
        </style>
  </head>
  <body>
    <dl>
      %s
      <span id='temp_f'><dt>Temperature</dt><dd><span id='temp_f_val'>%0.2f</span>&deg; F</dd></span>
      <span id='temp_c'><dt>Temperature</dt><dd><span id='temp_c_val'>%0.2f</span>&deg; C</dd></span>
      <span id='humidity'><dt>Humidity</dt><dd><span id='humidity_val'>%0.1f</span>%%</dd></span>
      <span id='co2'><dt>CO2</dt><dd><span id='co2_val'>%d</span> ppm</dd></span>
      <span id='timestamp'><dt>Updated</dt><dd><span id='timestamp_val'>%s</span></dd></span>
    </dl>
  </body>
</html>
)";

#ifdef DISPLAY_CELSIUS
  const char *tempCSS = "#temp_f { display: none; }";
  float displayTemp = lastTemperature;
  const char *tempUnit = "C";
#else
  const char *tempCSS = "#temp_c { display: none; }";
  float displayTemp = c_to_f(lastTemperature);
  const char *tempUnit = "F";
#endif

#if HISTORY_COUNT
  const char *chartHTML = "<a href='/chart' title='Chart' target='_chart'><img src='/chart.png' style='float: right;' width='32' height='32'></a>";
#else
  const char *chartHTML = "";
#endif

  char buf[4096];
  // Chart HTML, Display Temperature, Temperature Unit, CO2, use_celsius - "true" (for C) or "false" (for F), CSS, Chart HTML, F temp, C temp, Humidity, CO2, Last Update Timestamp
  snprintf(buf, sizeof(buf) - 1, html, displayTemp, tempUnit, lastCO2,                 // HTML Title (temperature float, temperature unit string, CO2 integer)
                                       strcmp(tempUnit, "C") == 0 ? "true" : "false",  // use_celsius: Celsius = "true", F = "false" string
                                       tempCSS,                                        // CSS string
                                       chartHTML,                                      // Chart HTML link
                                       c_to_f(lastTemperature), lastTemperature, lastHumidity, lastCO2, lastSensorLocaltime);

  AsyncWebServerResponse *response = request->beginResponse(200, "text/html", buf);
  response->addHeader("Cache-Control", "no-cache");
  request->send(response);
  
  Serial.println("HTTP request complete: / [" + String(millis()) + "]");
}

void httpXMLHandler(AsyncWebServerRequest *request)
{
  Serial.println("HTTP request from " + request->client()->remoteIP().toString() + ": /xml [" + String(millis()) + "]");

  char buf[1024];
  to_xml(lastTemperature, lastHumidity, lastCO2, lastSensorTimestamp, buf, sizeof(buf));

  AsyncWebServerResponse *response = request->beginResponse(200, "application/xml", buf);
  response->addHeader("Access-Control-Allow-Origin", "*");
  response->addHeader("Cache-Control", "no-cache");
  request->send(response);
    
  Serial.println("HTTP request complete: /xml [" + String(millis()) + "]");
}

void httpJSONHandler(AsyncWebServerRequest *request)
{
  Serial.println("HTTP request from " + request->client()->remoteIP().toString() + ": /json [" + String(millis()) + "]");

  char buf[1024];
  to_json(lastTemperature, lastHumidity, lastCO2, lastSensorTimestamp, buf, sizeof(buf));

  AsyncWebServerResponse *response = request->beginResponse(200, "application/json", buf);
  response->addHeader("Access-Control-Allow-Origin", "*");
  response->addHeader("Cache-Control", "no-cache");
  request->send(response);

  Serial.println("HTTP request complete: /json [" + String(millis()) + "]");
}

#if HISTORY_COUNT
void httpChartHandler(AsyncWebServerRequest *request)
{
  Serial.println("HTTP request from " + request->client()->remoteIP().toString() + ": /chart [" + String(millis()) + "]");

  const char *html = R"(
<html>
<head>
    <title>Dayclock - History Chart</title>
    <meta charset='UTF-8'>
    <script src='https://cdnjs.cloudflare.com/ajax/libs/moment.js/2.18.1/moment.min.js'></script>
    <script src='https://cdnjs.cloudflare.com/ajax/libs/Chart.js/2.9.3/Chart.min.js'></script>
    <style>
        canvas 
        {
            -moz-user-select: none;
            -webkit-user-select: none;
            -ms-user-select: none;
        }
    </style>
</head>
<body onload='getData()'>
    <div style='width:80%%;margin-left:auto;margin-right:auto;'>
        <canvas id='chart'></canvas>
    </div>
    <script>
        var data = null;

        function getData(do_async=true) {
            let xmlhttp = new XMLHttpRequest();
            xmlhttp.onreadystatechange = function() {
                if (this.readyState == 4 && this.status == 200) {
                    data = JSON.parse(this.responseText);
                    updateChart();
                }
            }
            xmlhttp.open('GET', '/history', do_async);
            xmlhttp.send();
        }
        
        function getCO2Data() {
            let l = [];
            if(data !== null)
                data.forEach(item => { l.push({t: new Date(item[0] * 1000), y: item[4]}); });
            return l;
        }

        function getTemperatureData() {
            let l = []
            if(data !== null)
                data.forEach(item => { l.push({t: new Date(item[0] * 1000), y: item[%d]}); });
            return l;
        }
        
        function getHumidityData() {
            let l = []
            if(data !== null)
                data.forEach(item => { l.push({t: new Date(item[0] * 1000), y: item[3]}); });
            return l;
        }
        
        function updateChart() {
            if(data === null)
                console.log('updateChart - data is null');
                
            chart.data.datasets[0].data = getCO2Data();
            chart.data.datasets[1].data = getTemperatureData();
            chart.data.datasets[2].data = getHumidityData();
            chart.update();
        }

        var ctx = document.getElementById('chart').getContext('2d');
        var cfg = {
            data: {
                datasets: [{
                    label: 'CO2 (ppm)',
                    backgroundColor: '#4dc9f6',
                    borderColor: '#4dc9f6',
                    data: getCO2Data(),
                    type: 'line',
                    pointRadius: 0,
                    fill: false,
                    lineTension: 1,
                    cubicInterpolationMode: 'monotone',
                    borderWidth: 2,
                    yAxisID: 'y-axis-1',
                },
                {
                    label: 'Temperature (°%s)',
                    backgroundColor: '#f00000',
                    borderColor: '#f00000',
                    data: getTemperatureData(),
                    type: 'line',
                    pointRadius: 0,
                    fill: false,
                    lineTension: 1,
                    cubicInterpolationMode: 'monotone',
                    borderWidth: 2,
                    yAxisID: 'y-axis-2',
                },
                {
                    label: 'Humidity (%%)',
                    backgroundColor: '#42f5b3',
                    borderColor: '#42f5b3',
                    data: getHumidityData(),
                    type: 'line',
                    pointRadius: 0,
                    fill: false,
                    lineTension: 1,
                    cubicInterpolationMode: 'monotone',
                    borderWidth: 2,
                    yAxisID: 'y-axis-3',
                    hidden: true,
                }],
            },
            options: {
                responsive: true,
                animation: {
                    duration: 0
                },
                scales: {
                    xAxes: [{
                        type: 'time',
                        distribution: 'series',
                        offset: true,
                        ticks: {
                            major: {
                                enabled: true,
                                fontStyle: 'bold'
                            },
                            source: 'data',
                            autoSkip: true,
                            autoSkipPadding: 75,
                            maxRotation: 0,
                            sampleSize: 100
                        },
                        afterBuildTicks: function(scale, ticks) {
                            if(ticks === null)
                                return;
                            var majorUnit = scale._majorUnit;
                            var firstTick = ticks[0];
                            var i, ilen, val, tick, currMajor, lastMajor;

                            val = moment(ticks[0].value);
                            if (val.second() === 0) {
                                firstTick.major = true;
                            } else {
                                firstTick.major = false;
                            }
                            lastMajor = val.get(majorUnit);

                            for (i = 1, ilen = ticks.length; i < ilen; i++) {
                                tick = ticks[i];
                                val = moment(tick.value);
                                currMajor = val.get(majorUnit);
                                tick.major = currMajor !== lastMajor;
                                lastMajor = currMajor;
                            }
                            return ticks;
                        }
                    }],
                    yAxes: [{
                        gridLines: {
                            drawBorder: false
                        },
                        scaleLabel: {
                            display: true,
                            labelString: 'CO2 (ppm)'
                        },
                        position: 'left',
                        id: 'y-axis-1',
                        display: 'auto',
                        suggestedMin: 350,
                        suggestedMax: 4000
                    },
                    {
                        gridLines: {
                            drawBorder: false,
                            display: false
                        },
                        scaleLabel: {
                            display: true,
                            labelString: 'Temperature (°%s)'
                        },
                        position: 'right',
                        id: 'y-axis-2',
                        display: 'auto'
                    },
                    {
                        gridLines: {
                            drawBorder: false,
                            display: false
                        },
                        scaleLabel: {
                            display: true,
                            labelString: 'Humidity (%%)'
                        },
                        position: 'right',
                        id: 'y-axis-3',
                        display: 'auto'
                    }
                    ]
                },
                tooltips: {
                    intersect: false,
                    mode: 'index',
                    callbacks: {
                        label: function(tooltipItem, myData) {
                            var label = myData.datasets[tooltipItem.datasetIndex].label || '';
                            if (label) {
                                label += ': ';
                            }
                            label += tooltipItem.value;
                            return label;
                        }
                    }
                }
            }
        };

        var chart = new Chart(ctx, cfg);
        setInterval(getData, 30000);
    </script>
</body>
</html>
)";

#ifdef DISPLAY_CELSIUS
  int tempIndex = 2;
  const char *tempUnit = "C";
#else
  int tempIndex = 1;
  const char *tempUnit = "F";
#endif

  char buf[10000];
  snprintf(buf, sizeof(buf) - 1, html, tempIndex, tempUnit, tempUnit);
  
  AsyncWebServerResponse *response = request->beginResponse(200, "text/html", buf);
  response->addHeader("Cache-Control", "no-cache");
  request->send(response);
  
  Serial.println("HTTP request complete: /chart [" + String(millis()) + "]");
}

void httpHistoryHandler(AsyncWebServerRequest *request)
{
  Serial.println("HTTP request from " + request->client()->remoteIP().toString() + ": /history [" + String(millis()) + "]");

  // Returns a JSON list of [Timestamp, Temperature (F), Temperature (C), Humidity, CO2]
  AsyncResponseStream *response = request->beginResponseStream("application/json");
  response->addHeader("Access-Control-Allow-Origin", "*");
  response->addHeader("Cache-Control", "no-cache");
  response->print("[");

  inHistoryHandler = true;
  bool hasOutput = false;
  history_t *h;
  int pos = 0;
  unsigned int minTimestamp = 0;
  int minPos = 0;
  
  // Find the initial position based on the lowest timestamp
  for(int i=0; i<HISTORY_COUNT; i++)
  {
    h = get_history(i);
    if(h->timestamp == 0)
      break;

    if(minTimestamp == 0 || h->timestamp < minTimestamp)
    {
      minTimestamp = h->timestamp;
      minPos = i;
    }
  }

  pos = minPos;

  for(int i=0; i<HISTORY_COUNT; i++)
  {
    h = get_history(pos);
    if(h->timestamp == 0)
      break;

    if(hasOutput == true)
      response->print(",");
      
    response->printf("[%lu,%0.1f,%0.1f,%0.1f,%u]", h->timestamp, round_to_tenths(c_to_f(h->temperature)), round_to_tenths(h->temperature), round_to_tenths(h->humidity), h->co2);
    hasOutput = true;  

    pos = get_next_index(pos);
  }
  
  inHistoryHandler = false;
  
  response->print("]");
  request->send(response);

  
  Serial.println("HTTP request complete: /history [" + String(millis()) + "]");
}
#endif

void httpUpdateHandler(AsyncWebServerRequest *request)
{
  const char *html = "<html><head><title>Firmware Update</title></head><body><form method='POST' action='/do_update' enctype='multipart/form-data'><input type='file' name='update'><input type='submit' value='Update'></form></body></html>";
  AsyncWebServerResponse *response = request->beginResponse(200, "text/html", html);
  response->addHeader("Cache-Control", "no-cache");
  request->send(response);
}

void httpDoUpdateHandler(AsyncWebServerRequest *request, const String& filename, size_t index, uint8_t *data, size_t len, bool final) 
{
  if (!index)
  {
    Serial.println("Update Starting");
    updateContentLen = request->contentLength();

    lcd.setCursor(0, 0);
    lcd.print("Updating                           ");
    lcd.setCursor(0, 1);
    lcd.print(String(updateContentLen) + " bytes        ");
           
    // if filename includes spiffs, update the spiffs partition
    int cmd = (filename.indexOf("spiffs") > -1) ? U_SPIFFS : U_FLASH;
#ifdef ESP8266
    Update.runAsync(true);
    if (!Update.begin(updateContentLen, cmd)) 
    {
#else
    if (!Update.begin(UPDATE_SIZE_UNKNOWN, cmd))
    {
#endif
      updateContentLen = 0;
      Update.printError(Serial);
    }
  }

  if (Update.write(data, len) != len) 
  {
    updateContentLen = 0;
    Update.printError(Serial);
#ifdef ESP8266
  } 
  else 
  {
    Serial.printf("Progress: %d%%\n", (Update.progress() * 100) / Update.size());
#endif
  }

  if (final) 
  {
    if (!Update.end(true))
    {
      updateContentLen = 0;
      Update.printError(Serial);

      const char *html = "<html><head><meta http-equiv='refresh' content='5; url=/update'><title>Update Failed</title></head></html>";
      request->send(200, "text/html", html);
    } 
    else
    {
      const char *html = "<html><head><meta http-equiv='refresh' content='10; url=/'><title>Rebooting</title></head><body>Rebooting...</body></html>";
      request->send(200, "text/html", html);
      update_reboot();
    }
  }
}

void update_reboot()
{
  lcd.setCursor(0, 0);
  lcd.print("Update Complete - Rebooting        ");
  lcd.setCursor(0, 1);
  lcd.print("                                   ");

  Serial.println("Update complete");
  Serial.flush();

  delay(3000);
  ESP.restart();
}

void update_print_progress(size_t prg, size_t sz) 
{
  int mapping[100];
  float pos = 180;
  for(int i=0; i<100; i++)
  {
    mapping[i] = int(pos);
    pos -= 1.8;
  }
  
  int progress = (prg * 100) / updateContentLen;
  Serial.printf("Progress: %d%%\n", progress);
  servo.write(mapping[progress]);
}

void httpFaviconHandler(AsyncWebServerRequest *request)
{
  const uint8_t iconData[283] PROGMEM = {
  0x89, 0x50, 0x4E, 0x47, 0x0D, 0x0A, 0x1A, 0x0A, 0x00, 0x00, 0x00, 0x0D,
  0x49, 0x48, 0x44, 0x52, 0x00, 0x00, 0x00, 0x10, 0x00, 0x00, 0x00, 0x10,
  0x08, 0x04, 0x00, 0x00, 0x00, 0xB5, 0xFA, 0x37, 0xEA, 0x00, 0x00, 0x00,
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  0x45, 0x4E, 0x44, 0xAE, 0x42, 0x60, 0x82
};
  AsyncWebServerResponse *response = request->beginResponse_P(200, "image/x-icon", iconData, sizeof(iconData));
  request->send(response);
}

#if HISTORY_COUNT
void httpChartIconHandler(AsyncWebServerRequest *request)
{
  const uint8_t iconData[1426] PROGMEM = {
  0x89, 0x50, 0x4E, 0x47, 0x0D, 0x0A, 0x1A, 0x0A, 0x00, 0x00, 0x00, 0x0D,
  0x49, 0x48, 0x44, 0x52, 0x00, 0x00, 0x00, 0x20, 0x00, 0x00, 0x00, 0x20,
  0x08, 0x06, 0x00, 0x00, 0x00, 0x73, 0x7A, 0x7A, 0xF4, 0x00, 0x00, 0x00,
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  0x00, 0x00, 0x49, 0x45, 0x4E, 0x44, 0xAE, 0x42, 0x60, 0x82
};
  AsyncWebServerResponse *response = request->beginResponse_P(200, "image/png", iconData, sizeof(iconData));
  request->send(response);
}
#endif
